## boards/shields/kibard/Kconfig.shield
```kconfig
config SHIELD_KIBARD_LEFT
    def_bool $(shields_list_contains,kibard_left)

config SHIELD_KIBARD_RIGHT
    def_bool $(shields_list_contains,kibard_right)
```

## src/appcompanion/Kconfig
```kconfig
config ZMK_LAYER_STATUS_BLE_HID
    bool "Layer status in keyboard report via BLE HID"
    default y
    depends on (ZMK_BLE) && (!ZMK_SPLIT || ZMK_SPLIT_ROLE_CENTRAL)
    help
        Embed layer number in the keyboard HID report's reserved byte.

config ZMK_LAYER_STATUS_USB_HID
    bool "Layer status via USB HID raw reports"
    default y
    depends on (ZMK_USB) && (!ZMK_SPLIT || ZMK_SPLIT_ROLE_CENTRAL)
    select USB_DEVICE_STACK
    select USB_DEVICE_HID
    help
        Send layer state changes via USB HID raw reports.
        Requires CONFIG_USB_HID_DEVICE_COUNT >= 2.

config ZMK_LAYER_STATUS_USB_HID_USAGE_PAGE
    hex "USB HID Usage Page"
    default 0xFF60
    depends on ZMK_LAYER_STATUS_USB_HID

config ZMK_LAYER_STATUS_USB_HID_USAGE
    hex "USB HID Usage"
    default 0x61
    depends on ZMK_LAYER_STATUS_USB_HID
```
