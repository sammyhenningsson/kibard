/*
 * Copyright (c) 2020 The ZMK Contributors
 *
 * SPDX-License-Identifier: MIT
 */

#include <behaviors.dtsi>
#include <dt-bindings/zmk/keys.h>
#include <dt-bindings/zmk/bt.h>
#include <dt-bindings/zmk/pointing.h>
#include <input/processors.dtsi>

#define SE_CIRC LS(RIGHT_BRACKET)
#define SE_DOLLAR RA(N4)
#define SE_COLON LS(DOT)
#define SE_SEMI LS(COMMA)
#define SE_AMPR LS(N6)
#define SE_ACUT EQUAL
#define SE_AT RA(N2)
#define SE_SLASH LS(N7)
#define SE_QUES LS(MINUS)
#define SE_DQUOT LS(N2)
#define SE_APOS NUHS
#define SE_LESS NUBS
#define SE_MINUS FSLH
#define SE_UNDER LS(FSLH)
#define SE_EQUAL LS(N0)
#define SE_GRTR LS(NUBS)
#define SE_LBRACE RA(N7)
#define SE_RBRACE RA(N0)
#define SE_BSLS RA(MINUS)
#define SE_TILDE RA(RIGHT_BRACKET)
#define SE_LPAR LS(N8)
#define SE_RPAR LS(N9)
#define SE_PLUS MINUS
#define SE_ASTR LS(NUHS)
#define SE_GRAV LS(EQUAL)
#define SE_LBRACKET RA(N8)
#define SE_RBRACKET RA(N9)
#define SE_PIPE RA(NUBS)
#define SE_SECT GRAV
#define SE_PERCENT LS(N5)
#define SE_EXCLAM LS(N1)
#define SE_POUND LS(N3)
#define SE_MICRO RA(M)
#define SE_EURO RA(N5)
#define SE_STERLING RA(N3)
#define SE_ADIA APOS
#define SE_AA LEFT_BRACKET
#define SE_OO SEMI

#define L_GRAPHMOD 0
#define L_SYM 1
#define L_SYMP 2
#define L_NUM 3
#define L_MOUSE 4
#define L_ALPHAP 5
#define L_NAV 6
#define L_VIM 7
#define L_FUNC 8
#define L_BT 9
#define L_HEX 10
// Speed modifiers for the Mouse layer: all-&trans layers that exist only so the
// pointer/scroll input listeners can scale their events while one is held.
#define L_MFAST 11
#define L_MSLOW 12
#define L_MAIN L_GRAPHMOD

// MEH = Ctrl + Shift + Alt
#define MEH LC(LS(LALT))

// Ctrl + Alt, on the M and I holds
#define CTRL_ALT LC(LALT)

// Shortcuts for workspaces
#define WS_L LC(LA(LEFT))
#define WS_R LC(LA(RIGHT))
#define WSM_L LS(LA(LEFT))
#define WSM_R LS(LA(RIGHT))


/ {
    behaviors {
        HML: HML {
            compatible = "zmk,behavior-hold-tap";
            bindings = <&kp>, <&kp>;

            #binding-cells = <2>;
            tapping-term-ms = <250>;
            quick-tap-ms = <175>;
            flavor = "balanced";
            hold-trigger-on-release;
            require-prior-idle-ms = <150>;
            hold-trigger-key-positions = <5 6 7 8 9 15 16 17 18 19 25 26 27 28 29>;
        };

        HMR: HMR {
            compatible = "zmk,behavior-hold-tap";
            bindings = <&kp>, <&kp>;

            #binding-cells = <2>;
            tapping-term-ms = <250>;
            quick-tap-ms = <175>;
            flavor = "balanced";
            hold-trigger-on-release;
            require-prior-idle-ms = <150>;
            hold-trigger-key-positions = <0 1 2 3 4 10 11 12 13 14 20 21 22 23 24>;
        };

        // HML/HMR for Shift: a shorter require-prior-idle-ms, so a capital
        // right after a letter can still be held into Shift.
        HML_SFT: HML_SFT {
            compatible = "zmk,behavior-hold-tap";
            bindings = <&kp>, <&kp>;

            #binding-cells = <2>;
            tapping-term-ms = <250>;
            quick-tap-ms = <175>;
            flavor = "balanced";
            hold-trigger-on-release;
            require-prior-idle-ms = <100>;
            hold-trigger-key-positions = <5 6 7 8 9 15 16 17 18 19 25 26 27 28 29>;
        };

        HMR_SFT: HMR_SFT {
            compatible = "zmk,behavior-hold-tap";
            bindings = <&kp>, <&kp>;

            #binding-cells = <2>;
            tapping-term-ms = <250>;
            quick-tap-ms = <175>;
            flavor = "balanced";
            hold-trigger-on-release;
            require-prior-idle-ms = <100>;
            hold-trigger-key-positions = <0 1 2 3 4 10 11 12 13 14 20 21 22 23 24>;
        };

        // HML with a momentary layer as the hold (N -> Mouse). The thumbs also
        // count as hold triggers, so the Mouse layer's speed keys (pos 30/31)
        // work right after pressing it.
        HML_LT: HML_LT {
            compatible = "zmk,behavior-hold-tap";
            bindings = <&mo>, <&kp>;

            #binding-cells = <2>;
            tapping-term-ms = <250>;
            quick-tap-ms = <175>;
            flavor = "balanced";
            hold-trigger-on-release;
            require-prior-idle-ms = <150>;
            hold-trigger-key-positions = <5 6 7 8 9 15 16 17 18 19 25 26 27 28 29 30 31 32 33>;
        };

        HT_TO: HT_TO {
            compatible = "zmk,behavior-hold-tap";
            bindings = <&to>, <&kp>;

            #binding-cells = <2>;
            tapping-term-ms = <250>;
            flavor = "tap-preferred";
        };

        NUM: NUM {
            compatible = "zmk,behavior-hold-tap";
            bindings = <&kp>, <&kp>;

            #binding-cells = <2>;
            tapping-term-ms = <200>;
            quick-tap-ms = <175>;
            require-prior-idle-ms = <150>;
            flavor = "tap-preferred";
        };
// CAP(k): tap for k, hold for Shift+k. Uses NUM, not a home-row mod: the
// hold is a capital letter, so only hold time should decide, not what the
// other hand presses.
#define CAP(k) &NUM LS(k) k

        LT_TH: LT_TH {
            compatible = "zmk,behavior-hold-tap";
            bindings = <&mo>, <&kp>;

            #binding-cells = <2>;
            tapping-term-ms = <200>;
            quick-tap-ms = <150>;
            flavor = "hold-preferred";
        };

        LT_SPC: LT_SPC {
            compatible = "zmk,behavior-hold-tap";
            bindings = <&mo>, <&kp>;

            #binding-cells = <2>;
            tapping-term-ms = <200>;
            quick-tap-ms = <150>;
            require-prior-idle-ms = <150>;
            flavor = "balanced";
        };

        // Adaptive keys on Graphmod. Two are swaps [X, Y, Z]: right after X,
        // keys Y and Z trade places, via a pair of adaptive keys pointing at
        // each other: [U, E, O] and [S, D, C]. The rest are one-way: HD -> HÅ,
        // HK -> HJ, GK -> GY, KC -> KE, KP -> KO, PK -> PO, PC -> PR, FC -> FL, FQ -> FJ,
        // OQ -> OA, GW -> GS, KW -> KU, and C repeats L or M: LC -> LL, MC -> MM.
        // Output is a plain &kp: a rule only fires mid-word, where a hold is
        // unwanted.
        //
        // A rule only fires while typing: the trigger must have been pressed
        // less than AS_IDLE_MS ago, with no modifier other than Shift
        // (strict-modifiers plus the shifted triggers), so Ctrl+F then C
        // still types C.
#define AS_IDLE_MS 400
#define AS_TRIGGER(k) k LS(k) RS(k)
#define AS_GUARD max-prior-idle-ms = <AS_IDLE_MS>; strict-modifiers;
        AS_E: AS_E {
            compatible = "zmk,behavior-adaptive-key";
            #binding-cells = <0>;
            bindings = <&HMR_SFT RSHIFT E>;

            as_ue { trigger-keys = <AS_TRIGGER(U)>; bindings = <&kp O>; AS_GUARD };
        };

        AS_O: AS_O {
            compatible = "zmk,behavior-adaptive-key";
            #binding-cells = <0>;
            bindings = <&kp O>;

            as_uo { trigger-keys = <AS_TRIGGER(U)>; bindings = <&kp E>; AS_GUARD };
        };

        AS_D: AS_D {
            compatible = "zmk,behavior-adaptive-key";
            #binding-cells = <0>;
            bindings = <&kp D>;

            as_sd { trigger-keys = <AS_TRIGGER(S)>; bindings = <&kp C>; AS_GUARD };
            as_hd { trigger-keys = <AS_TRIGGER(H)>; bindings = <&kp SE_AA>; AS_GUARD };
        };

        AS_C: AS_C {
            compatible = "zmk,behavior-adaptive-key";
            #binding-cells = <0>;
            bindings = <&kp C>;

            as_sc { trigger-keys = <AS_TRIGGER(S)>; bindings = <&kp D>; AS_GUARD };
            as_kc { trigger-keys = <AS_TRIGGER(K)>; bindings = <&kp E>; AS_GUARD };
            as_fc { trigger-keys = <AS_TRIGGER(F)>; bindings = <&kp L>; AS_GUARD };
            as_lc { trigger-keys = <AS_TRIGGER(L)>; bindings = <&kp L>; AS_GUARD };
            as_mc { trigger-keys = <AS_TRIGGER(M)>; bindings = <&kp M>; AS_GUARD };
            as_pc { trigger-keys = <AS_TRIGGER(P)>; bindings = <&kp R>; AS_GUARD };
        };

        AS_Q: AS_Q {
            compatible = "zmk,behavior-adaptive-key";
            #binding-cells = <0>;
            bindings = <&kp Q>;

            as_fq { trigger-keys = <AS_TRIGGER(F)>; bindings = <&kp J>; AS_GUARD };
            as_oq { trigger-keys = <AS_TRIGGER(O)>; bindings = <&kp A>; AS_GUARD };
        };

        AS_P: AS_P {
            compatible = "zmk,behavior-adaptive-key";
            #binding-cells = <0>;
            bindings = <&kp P>;

            as_kp { trigger-keys = <AS_TRIGGER(K)>; bindings = <&kp O>; AS_GUARD };
        };

        AS_K: AS_K {
            compatible = "zmk,behavior-adaptive-key";
            #binding-cells = <0>;
            bindings = <&kp K>;

            as_hk { trigger-keys = <AS_TRIGGER(H)>; bindings = <&kp J>; AS_GUARD };
            as_pk { trigger-keys = <AS_TRIGGER(P)>; bindings = <&kp O>; AS_GUARD };
            as_gk { trigger-keys = <AS_TRIGGER(G)>; bindings = <&kp Y>; AS_GUARD };
        };

        AS_W: AS_W {
            compatible = "zmk,behavior-adaptive-key";
            #binding-cells = <0>;
            bindings = <&lt L_BT W>;

            as_gw { trigger-keys = <AS_TRIGGER(G)>; bindings = <&kp S>; AS_GUARD };
            as_kw { trigger-keys = <AS_TRIGGER(K)>; bindings = <&kp U>; AS_GUARD };
        };


        // One-way adaptive keys on Alpha+: right after J, P, S, N, Å, F, M, Ö, V or A, a key
        // on the same layer types the letter that usually follows, so the
        // thumb never has to let go of Alpha+. JT -> JU, PX -> PP, JS -> JO,
        // SX -> SK, ÅX -> ÅE, NS -> NN, ÅS -> ÅR, FD -> FÖ, MT -> MÖ, ÖS -> ÖR, VP -> VÄ, MS -> MC, AB -> AG. FD and ÖS chain: F, then D
        // and S on Alpha+, types FÖR. Like the Graphmod ones, they only fire within
        // AS_IDLE_MS of the trigger; modifiers aren't checked.
        AK_X: AK_X {
            compatible = "zmk,behavior-adaptive-key";
            #binding-cells = <0>;
            bindings = <&HMR LCTRL X>;

            ak_px { trigger-keys = <P>; bindings = <&kp P>; max-prior-idle-ms = <AS_IDLE_MS>; };
            ak_aax { trigger-keys = <SE_AA>; bindings = <&kp E>; max-prior-idle-ms = <AS_IDLE_MS>; };
            ak_sx { trigger-keys = <S>; bindings = <&kp K>; max-prior-idle-ms = <AS_IDLE_MS>; };
        };

        AK_P: AK_P {
            compatible = "zmk,behavior-adaptive-key";
            #binding-cells = <0>;
            bindings = <CAP(P)>;

            ak_vp { trigger-keys = <V>; bindings = <&kp SE_ADIA>; max-prior-idle-ms = <AS_IDLE_MS>; };
        };

        AK_S: AK_S {
            compatible = "zmk,behavior-adaptive-key";
            #binding-cells = <0>;
            bindings = <&HML_SFT LSHIFT S>;

            ak_aas { trigger-keys = <SE_AA SE_OO>; bindings = <&kp R>; max-prior-idle-ms = <AS_IDLE_MS>; };
            ak_ns { trigger-keys = <N>; bindings = <&kp N>; max-prior-idle-ms = <AS_IDLE_MS>; };
            ak_js { trigger-keys = <J>; bindings = <&kp O>; max-prior-idle-ms = <AS_IDLE_MS>; };
            ak_ms { trigger-keys = <M>; bindings = <&kp C>; max-prior-idle-ms = <AS_IDLE_MS>; };
        };

        AK_D: AK_D {
            compatible = "zmk,behavior-adaptive-key";
            #binding-cells = <0>;
            bindings = <&kp D>;

            ak_fd { trigger-keys = <F>; bindings = <&kp SE_OO>; max-prior-idle-ms = <AS_IDLE_MS>; };
        };

        AK_T: AK_T {
            compatible = "zmk,behavior-adaptive-key";
            #binding-cells = <0>;
            bindings = <&HML LCTRL T>;

            ak_mt { trigger-keys = <M>; bindings = <&kp SE_OO>; max-prior-idle-ms = <AS_IDLE_MS>; };
            ak_jt { trigger-keys = <J>; bindings = <&kp U>; max-prior-idle-ms = <AS_IDLE_MS>; };
        };

        // Contractions on Symbols: right after the apostrophe, ( types T,
        // ) types S, = types V, { types D and } types M, so don't, it's,
        // I've, I'd and I'm end without leaving the layer. Same AS_IDLE_MS
        // window as the rest.
        AK_LPAR: AK_LPAR {
            compatible = "zmk,behavior-adaptive-key";
            #binding-cells = <0>;
            bindings = <&HMR LALT SE_LPAR>;

            ak_apos_lpar { trigger-keys = <SE_APOS>; bindings = <&kp T>; max-prior-idle-ms = <AS_IDLE_MS>; };
        };

        AK_RPAR: AK_RPAR {
            compatible = "zmk,behavior-adaptive-key";
            #binding-cells = <0>;
            bindings = <&HMR RCTRL SE_RPAR>;

            ak_apos_rpar { trigger-keys = <SE_APOS>; bindings = <&kp S>; max-prior-idle-ms = <AS_IDLE_MS>; };
        };

        AK_EQUAL: AK_EQUAL {
            compatible = "zmk,behavior-adaptive-key";
            #binding-cells = <0>;
            bindings = <&kp SE_EQUAL>;

            ak_apos_equal { trigger-keys = <SE_APOS>; bindings = <&kp V>; max-prior-idle-ms = <AS_IDLE_MS>; };
        };

        AK_LBRACE: AK_LBRACE {
            compatible = "zmk,behavior-adaptive-key";
            #binding-cells = <0>;
            bindings = <&kp SE_LBRACE>;

            ak_apos_lbrace { trigger-keys = <SE_APOS>; bindings = <&kp D>; max-prior-idle-ms = <AS_IDLE_MS>; };
        };

        AK_RBRACE: AK_RBRACE {
            compatible = "zmk,behavior-adaptive-key";
            #binding-cells = <0>;
            bindings = <&kp SE_RBRACE>;

            ak_apos_rbrace { trigger-keys = <SE_APOS>; bindings = <&kp M>; max-prior-idle-ms = <AS_IDLE_MS>; };
        };
    };
};

        //                               Key positions
        //
        //╭────┬────┬────┬────┬────╮                      ╭────┬────┬────┬────┬────╮
        //    0    1    2    3    4                           5    6    7    8    9
        //├────┼────┼────┼────┼────┤                      ├────┼────┼────┼────┼────┤
        //   10   11   12   13   14                          15   16   17   18   19
        //├────┼────┼────┼────┼────┤                      ├────┼────┼────┼────┼────┤
        //   20   21   22   23   24                          25   26   27   28   29
        //╰────┴────┴────┬────┼────┤                      ├────┼────┴────┴────┴────╯
        //                  30   31                          32   33
        //               ╰────┴────╯                      ╰────┴────╯


// Mouse speed control. `&mmv`/`&msc` feed their events through these listeners,
// so scaling them here changes pointer/scroll speed without touching a single
// binding: on the Mouse layer hold pos 31 (left inner thumb) for L_MFAST or
// pos 30 (left outer thumb) for L_MSLOW while the right hand drives the mouse.
// Both are `&trans` layers, so the Mouse layer keeps working underneath.
//
// The parameters are <multiplier divisor>, max 16 each. Tune here only.
&mmv_input_listener {
    fast { layers = <L_MFAST>; input-processors = <&zip_xy_scaler 2 1>; };
    slow { layers = <L_MSLOW>; input-processors = <&zip_xy_scaler 1 4>; };
};

&msc_input_listener {
    fast { layers = <L_MFAST>; input-processors = <&zip_scroll_scaler 2 1>; };
    slow { layers = <L_MSLOW>; input-processors = <&zip_scroll_scaler 1 3>; };
};

/ {
    macros {
        vim_write: vim_write {
            compatible = "zmk,behavior-macro";
            #binding-cells = <0>;
            bindings
                = <&macro_press &kp LSHFT>
                , <&macro_tap &kp DOT>
                , <&macro_release &kp LSHFT>
                , <&macro_tap &kp W>
                , <&macro_tap &kp RET>
                ;
        };

        vim_close: vim_close {
            compatible = "zmk,behavior-macro";
            #binding-cells = <0>;
            bindings
                = <&macro_press &kp LSHFT>
                , <&macro_tap &kp DOT>
                , <&macro_release &kp LSHFT>
                , <&macro_tap &kp Q>
                , <&macro_tap &kp RET>
                ;
        };

        vim_close_all: vim_close_all {
            compatible = "zmk,behavior-macro";
            #binding-cells = <0>;
            bindings
                = <&macro_press &kp LSHFT>
                , <&macro_tap &kp DOT>
                , <&macro_release &kp LSHFT>
                , <&macro_tap &kp Q &kp A>
                , <&macro_tap &kp RET>
                ;
        };

        vim_mk_session: vim_mk_session {
            compatible = "zmk,behavior-macro";
            #binding-cells = <0>;
            bindings
                = <&macro_press &kp LSHFT>
                , <&macro_tap &kp DOT>
                , <&macro_release &kp LSHFT>
                , <&macro_tap &kp M &kp K &kp S &kp E &kp S &kp S &kp I &kp O &kp N>
                , <&macro_press &kp LSHFT>
                , <&macro_tap &kp N1>
                , <&macro_release &kp LSHFT>
                , <&macro_tap &kp RET>
                ;
        };

        vim_gwrite: vim_gwrite {
            compatible = "zmk,behavior-macro";
            #binding-cells = <0>;
            bindings
                = <&macro_press &kp LSHFT>
                , <&macro_tap &kp DOT>
                , <&macro_tap &kp G>
                , <&macro_release &kp LSHFT>
                , <&macro_tap &kp W &kp R &kp I &kp T &kp E>
                , <&macro_tap &kp RET>
                ;
        };

        vim_discard: vim_discard {
            compatible = "zmk,behavior-macro";
            #binding-cells = <0>;
            bindings
                = <&macro_press &kp LSHFT>
                , <&macro_tap &kp DOT>
                , <&macro_release &kp LSHFT>
                , <&macro_tap &kp Q>
                , <&macro_tap &kp SE_EXCLAM>
                , <&macro_tap &kp RET>
                ;
        };

        vim_force_write: vim_force_write {
            compatible = "zmk,behavior-macro";
            #binding-cells = <0>;
            bindings
                = <&macro_press &kp LSHFT>
                , <&macro_tap &kp DOT>
                , <&macro_release &kp LSHFT>
                , <&macro_tap &kp W>
                , <&macro_tap &kp SE_EXCLAM>
                , <&macro_tap &kp RET>
                ;
        };

        vim_win_left: vim_win_left {
            compatible = "zmk,behavior-macro";
            #binding-cells = <0>;
            bindings
                = <&macro_press &kp LCTRL>
                , <&macro_tap &kp W>
                , <&macro_release &kp LCTRL>
                , <&macro_tap &kp H>
                ;
        };

        vim_win_down: vim_win_down {
            compatible = "zmk,behavior-macro";
            #binding-cells = <0>;
            bindings
                = <&macro_press &kp LCTRL>
                , <&macro_tap &kp W>
                , <&macro_release &kp LCTRL>
                , <&macro_tap &kp J>
                ;
        };

        vim_win_up: vim_win_up {
            compatible = "zmk,behavior-macro";
            #binding-cells = <0>;
            bindings
                = <&macro_press &kp LCTRL>
                , <&macro_tap &kp W>
                , <&macro_release &kp LCTRL>
                , <&macro_tap &kp K>
                ;
        };

        vim_win_right: vim_win_right {
            compatible = "zmk,behavior-macro";
            #binding-cells = <0>;
            bindings
                = <&macro_press &kp LCTRL>
                , <&macro_tap &kp W>
                , <&macro_release &kp LCTRL>
                , <&macro_tap &kp L>
                ;
        };

        vim_last_edit: vim_last_edit {
            compatible = "zmk,behavior-macro";
            #binding-cells = <0>;
            bindings
                = <&macro_tap &kp G>
                , <&macro_press &kp LSHIFT>
                , <&macro_tap &kp COMMA>
                , <&macro_release &kp LSHIFT>
                ;
        };

        acut: acut {
            compatible = "zmk,behavior-macro";
            #binding-cells = <0>;
            bindings
                = <&macro_tap &kp SE_ACUT>
                , <&macro_tap &kp SE_ACUT>
                ;
        };

        grav: grav {
            compatible = "zmk,behavior-macro";
            #binding-cells = <0>;
            bindings
                = <&macro_tap &kp SE_GRAV>
                , <&macro_tap &kp SPACE>
                ;
        };

        tilde: tilde {
            compatible = "zmk,behavior-macro";
            #binding-cells = <0>;
            bindings
                = <&macro_tap &kp SE_TILDE>
                , <&macro_tap &kp SPACE>
                ;
        };

        circ: circ {
            compatible = "zmk,behavior-macro";
            #binding-cells = <0>;
            bindings
                = <&macro_tap &kp SE_CIRC>
                , <&macro_tap &kp SPACE>
                ;
        };

        eacut: eacut {
            compatible = "zmk,behavior-macro";
            #binding-cells = <0>;
            bindings
                = <&macro_tap &kp SE_ACUT>
                , <&macro_tap &kp E>
                ;
        };

        ocirc: ocirc {
            compatible = "zmk,behavior-macro";
            #binding-cells = <0>;
            bindings
                = <&macro_tap &kp SE_CIRC>
                , <&macro_tap &kp O>
                ;
        };
    };
};

/ {
    combos {
        kompatible = "zmk,combos";

        combo_esc {
            timeout-ms = <40>;
            key-positions = <1 2>;
            bindings = <&kp ESC>;
            // Base layer only: on Alpha+, 1+2 are L and T and roll inside words.
            layers = <L_GRAPHMOD>;
        };
    };
};

/ {
    keymap {
        compatible = "zmk,keymap";

        default_layer {
            display-name = "Graphmod";
            bindings = <
                //╭─────────────────┬─────────────────┬─────────────────┬─────────────────┬─────────────────╮                      ╭─────────────────┬─────────────────┬─────────────────┬─────────────────┬─────────────────╮
                    &none             &AS_W             &AS_D             &kp G             &AS_Q                                    &kp BSPC          &lt L_FUNC F      &AS_O             &lt L_BT U        &none
                //├─────────────────┼─────────────────┼─────────────────┼─────────────────┼─────────────────┤                      ├─────────────────┼─────────────────┼─────────────────┼─────────────────┼─────────────────┤
                    &HML_LT L_MOUSE N &HML_SFT LSHIFT R &HML LCTRL T      &HML LALT S       &lt L_VIM B                              &lt L_VIM V       &HMR LALT H       &HMR RCTRL A      &AS_E             &HMR CTRL_ALT I
                //├─────────────────┼─────────────────┼─────────────────┼─────────────────┼─────────────────┤                      ├─────────────────┼─────────────────┼─────────────────┼─────────────────┼─────────────────┤
                    &kp Y             &AS_P             &HML CTRL_ALT M   &AS_C             &kp COMMA                                &kp DOT           &kp L             &kp SE_ADIA       &AS_K             &kp SE_OO
                //╰─────────────────┴─────────────────┼─────────────────┼─────────────────┼─────────────────┤                      ├─────────────────┼─────────────────┼─────────────────┼─────────────────┴─────────────────╯
                                                                          &LT_SPC L_NUM SPACE  &LT_TH L_SYM ESC                      &LT_TH L_NAV RET  &LT_TH L_ALPHAP TAB
                //                                                      ╰─────────────────┴─────────────────╯                      ╰─────────────────┴─────────────────╯
            >;
        };

        symbol_layer {
            display-name = "Symbols";
            bindings = <
                //╭─────────────────┬─────────────────┬─────────────────┬─────────────────┬─────────────────╮                      ╭─────────────────┬─────────────────┬─────────────────┬─────────────────┬─────────────────╮
                    &trans            &kp SE_GRAV       &kp SE_COLON      &kp SE_AMPR       &kp SE_CIRC                              &kp BSPC          &kp SE_LBRACKET   &kp SE_RBRACKET   &kp SE_BSLS       &trans
                //├─────────────────┼─────────────────┼─────────────────┼─────────────────┼─────────────────┤                      ├─────────────────┼─────────────────┼─────────────────┼─────────────────┼─────────────────┤
                    &LT_TH L_SYMP SE_AT  &HML_SFT LSHIFT SE_SLASH &HML LCTRL SE_QUES  &HML LALT SE_DQUOT  &kp SE_POUND               &AK_EQUAL         &AK_LPAR          &AK_RPAR          &HMR_SFT RSHIFT SE_APOS &kp SE_PLUS
                //├─────────────────┼─────────────────┼─────────────────┼─────────────────┼─────────────────┤                      ├─────────────────┼─────────────────┼─────────────────┼─────────────────┼─────────────────┤
                    &kp SE_PIPE       &kp SE_LESS       &kp SE_GRTR       &kp SE_EXCLAM     &kp SE_DOLLAR                            &kp SE_PERCENT    &AK_LBRACE        &AK_RBRACE        &kp SE_UNDER      &kp SE_MINUS
                //╰─────────────────┴─────────────────┼─────────────────┼─────────────────┼─────────────────┤                      ├─────────────────┼─────────────────┼─────────────────┼─────────────────┴─────────────────╯
                                                                          &trans            &trans                                   &kp SPACE         &kp SE_ASTR
                //                                                      ╰─────────────────┴─────────────────╯                      ╰─────────────────┴─────────────────╯
            >;
        };

        symbolplus_layer {
            display-name = "Symbols+";
            bindings = <
                //╭─────────────────┬─────────────────┬─────────────────┬─────────────────┬─────────────────╮                      ╭─────────────────┬─────────────────┬─────────────────┬─────────────────┬─────────────────╮
                    &none             &grav             &acut             &trans            &circ                                    &trans            &trans            &ocirc            &kp SE_MICRO      &trans
                //├─────────────────┼─────────────────┼─────────────────┼─────────────────┼─────────────────┤                      ├─────────────────┼─────────────────┼─────────────────┼─────────────────┼─────────────────┤
                    &trans            &kp SE_GRAV       &kp SE_ACUT       &trans            &trans                                   &trans            &kp SE_SLASH      &kp N             &eacut            &tilde
                //├─────────────────┼─────────────────┼─────────────────┼─────────────────┼─────────────────┤                      ├─────────────────┼─────────────────┼─────────────────┼─────────────────┼─────────────────┤
                    &trans            &trans            &trans            &trans            &trans                                   &trans            &kp SE_STERLING   &kp SE_EURO       &trans            &trans
                //╰─────────────────┴─────────────────┼─────────────────┼─────────────────┼─────────────────┤                      ├─────────────────┼─────────────────┼─────────────────┼─────────────────┴─────────────────╯
                                                                          &trans            &trans                                   &kp SPACE         &lt L_ALPHAP N0
                //                                                      ╰─────────────────┴─────────────────╯                      ╰─────────────────┴─────────────────╯
            >;
        };

        numpad_layer {
            display-name = "Numpad";
            bindings = <
                //╭─────────────────┬─────────────────┬─────────────────┬─────────────────┬─────────────────╮                      ╭─────────────────┬─────────────────┬─────────────────┬─────────────────┬─────────────────╮
                    &trans            &kp LC(V)         &kp LC(D)         &tog L_NUM        &kp LC(F)                                &kp BSPC          &kp N7            &kp N8            &kp N9            &trans
                //├─────────────────┼─────────────────┼─────────────────┼─────────────────┼─────────────────┤                      ├─────────────────┼─────────────────┼─────────────────┼─────────────────┼─────────────────┤
                    &kp RET           &HML_SFT LSHIFT LC(R) &kp SE_QUES   &kp SE_DQUOT      &kp SE_POUND                             &NUM SE_CIRC SE_ASTR  &NUM SE_LPAR N4  &NUM SE_RPAR N5   &NUM SE_EQUAL N6  &LT_TH L_HEX SE_PLUS
                //├─────────────────┼─────────────────┼─────────────────┼─────────────────┼─────────────────┤                      ├─────────────────┼─────────────────┼─────────────────┼─────────────────┼─────────────────┤
                    &to L_MAIN        &kp BSPC          &kp DEL           &kp LC(C)         &kp LC(Z)                                &HT_TO L_MAIN SE_SLASH  &NUM SE_COLON N1  &NUM COMMA N2  &NUM DOT N3    &NUM C_AL_CALC SE_MINUS
                //╰─────────────────┴─────────────────┼─────────────────┼─────────────────┼─────────────────┤                      ├─────────────────┼─────────────────┼─────────────────┼─────────────────┴─────────────────╯
                                                                          &trans            &trans                                   &kp SPACE         &lt L_ALPHAP N0
                //                                                      ╰─────────────────┴─────────────────╯                      ╰─────────────────┴─────────────────╯
            >;
        };

        mouse_layer {
            display-name = "Mouse";
            bindings = <
                //╭─────────────────┬─────────────────┬─────────────────┬─────────────────┬─────────────────╮                       ╭─────────────────┬─────────────────┬─────────────────┬─────────────────┬─────────────────╮
                    &trans            &kp LC(V)         &kp LC(D)         &tog L_MOUSE      &kp LC(F)                                 &kp BSPC          &msc SCRL_LEFT    &mmv MOVE_UP      &msc SCRL_RIGHT   &trans
                //├─────────────────┼─────────────────┼─────────────────┼─────────────────┼─────────────────┤                       ├─────────────────┼─────────────────┼─────────────────┼─────────────────┼─────────────────┤
                    &trans            &HML_SFT LSHIFT LC(R) &HML LCTRL LC(T)  &HML LALT LC(S)   &none                                 &none             &mmv MOVE_LEFT    &mmv MOVE_DOWN    &mmv MOVE_RIGHT   &msc SCRL_UP
                //├─────────────────┼─────────────────┼─────────────────┼─────────────────┼─────────────────┤                       ├─────────────────┼─────────────────┼─────────────────┼─────────────────┼─────────────────┤
                    &trans            &kp BSPC          &kp DEL           &kp LC(C)         &none                                     &to L_MAIN        &mkp MB1          &mkp MB3          &mkp MB2          &msc SCRL_DOWN
                //╰─────────────────┴─────────────────┼─────────────────┼─────────────────┼─────────────────┤                       ├─────────────────┼─────────────────┼─────────────────┼─────────────────┴─────────────────╯
                                                                          &mo L_MSLOW       &mo L_MFAST                               &mkp MB1          &mkp MB2
                //                                                      ╰─────────────────┴─────────────────╯                       ╰─────────────────┴─────────────────╯
            >;
        };

        alphaplus_layer {
            display-name = "Alpha+";
            bindings = <
                //╭─────────────────┬─────────────────┬─────────────────┬─────────────────┬─────────────────╮                      ╭─────────────────┬─────────────────┬─────────────────┬─────────────────┬─────────────────╮
                    &none             &kp L             &AK_D             &kp F             &kp PSCRN                                &kp BSPC          &kp I             &kp Z             &kp E             &none
                //├─────────────────┼─────────────────┼─────────────────┼─────────────────┼─────────────────┤                      ├─────────────────┼─────────────────┼─────────────────┼─────────────────┼─────────────────┤
                    &HML LGUI N       &AK_S             &AK_T             &HML LALT Y       &kp V                                    &kp DEL           &AK_P             &AK_X             &HMR_SFT RSHIFT SE_AA &kp RET
                //├─────────────────┼─────────────────┼─────────────────┼─────────────────┼─────────────────┤                      ├─────────────────┼─────────────────┼─────────────────┼─────────────────┼─────────────────┤
                    &kp B             &kp G             &kp A             CAP(J)            &none                                    &kp CAPS          &kp LS(INS)       &kp SE_MINUS      &kp SE_UNDER      &none
                //╰─────────────────┴─────────────────┼─────────────────┼─────────────────┼─────────────────┤                      ├─────────────────┼─────────────────┼─────────────────┼─────────────────┴─────────────────╯
                                                                          &trans            &caps_word                               &trans            &trans
                //                                                      ╰─────────────────┴─────────────────╯                      ╰─────────────────┴─────────────────╯
            >;
        };

        navigate_layer {
            display-name = "Navigate";
            bindings = <
                //╭─────────────────┬─────────────────┬─────────────────┬─────────────────┬─────────────────╮                      ╭─────────────────┬─────────────────┬─────────────────┬─────────────────┬─────────────────╮
                    &trans            &kp LG(L)         &to L_FUNC        &tog L_NAV        &kp K_VOL_UP                             &kp LA(LEFT)      &kp HOME          &kp END           &none             &trans
                //├─────────────────┼─────────────────┼─────────────────┼─────────────────┼─────────────────┤                      ├─────────────────┼─────────────────┼─────────────────┼─────────────────┼─────────────────┤
                    &kp LGUI          &kp LSHIFT        &kp RCTRL         &kp LALT          &kp K_VOL_DN                             &kp LEFT          &kp DOWN          &kp UP            &kp RIGHT         &kp PG_UP
                //├─────────────────┼─────────────────┼─────────────────┼─────────────────┼─────────────────┤                      ├─────────────────┼─────────────────┼─────────────────┼─────────────────┼─────────────────┤
                    &to L_MAIN        &kp BSPC          &kp DEL           &kp K_PP          &kp K_MUTE                               &to L_MAIN        &msc SCRL_LEFT    &msc SCRL_RIGHT   &to L_NUM         &kp PG_DN
                //╰─────────────────┴─────────────────┼─────────────────┼─────────────────┼─────────────────┤                      ├─────────────────┼─────────────────┼─────────────────┼─────────────────┴─────────────────╯
                                                                          &trans            &trans                                   &trans            &trans
                //                                                      ╰─────────────────┴─────────────────╯                      ╰─────────────────┴─────────────────╯
            >;
        };

        vim_layer {
            display-name = "Vim";
            bindings = <
                //╭─────────────────┬─────────────────┬─────────────────┬─────────────────┬─────────────────╮                      ╭─────────────────┬─────────────────┬─────────────────┬─────────────────┬─────────────────╮
                    &trans            &vim_force_write  &vim_mk_session   &tog L_VIM        &vim_close_all                           &vim_discard      &vim_write        &vim_gwrite       &vim_close        &trans
                //├─────────────────┼─────────────────┼─────────────────┼─────────────────┼─────────────────┤                      ├─────────────────┼─────────────────┼─────────────────┼─────────────────┼─────────────────┤
                    &trans            &kp LS(N)         &kp N             &kp G             &trans                                   &trans            &kp Y             &kp C             &kp I             &vim_last_edit
                //├─────────────────┼─────────────────┼─────────────────┼─────────────────┼─────────────────┤                      ├─────────────────┼─────────────────┼─────────────────┼─────────────────┼─────────────────┤
                    &to L_MAIN        &trans            &trans            &trans            &trans                                   &vim_win_left     &vim_win_down     &vim_win_up       &vim_win_right    &trans
                //╰─────────────────┴─────────────────┼─────────────────┼─────────────────┼─────────────────┤                      ├─────────────────┼─────────────────┼─────────────────┼─────────────────┴─────────────────╯
                                                                          &kp SE_SEMI       &trans                                   &kp N             &kp SE_COLON
                //                                                      ╰─────────────────┴─────────────────╯                      ╰─────────────────┴─────────────────╯
            >;
        };

        functions_layer {
            display-name = "Functions";
            bindings = <
                //╭─────────────────┬─────────────────┬─────────────────┬─────────────────┬─────────────────╮                      ╭─────────────────┬─────────────────┬─────────────────┬─────────────────┬─────────────────╮
                    &trans            &kp F6            &kp F7            &kp F8            &kp F9                                   &kp F15           &none             &none             &kp F20           &trans
                //├─────────────────┼─────────────────┼─────────────────┼─────────────────┼─────────────────┤                      ├─────────────────┼─────────────────┼─────────────────┼─────────────────┼─────────────────┤
                    &kp F1            &kp F2            &kp F3            &kp F4            &kp F5                                   &kp F10           &HMR LALT F11     &HMR RCTRL F12    &HMR_SFT RSHIFT F13 &HMR MEH F14
                //├─────────────────┼─────────────────┼─────────────────┼─────────────────┼─────────────────┤                      ├─────────────────┼─────────────────┼─────────────────┼─────────────────┼─────────────────┤
                    &to L_MAIN        &kp K_PREV        &kp K_PP          &kp K_STOP2       &kp K_NEXT                               &none             &none             &none             &none             &none
                //╰─────────────────┴─────────────────┼─────────────────┼─────────────────┼─────────────────┤                      ├─────────────────┼─────────────────┼─────────────────┼─────────────────┴─────────────────╯
                                                                          &trans            &trans                                   &trans            &trans
                //                                                      ╰─────────────────┴─────────────────╯                      ╰─────────────────┴─────────────────╯
            >;
        };

        bt_layer {
            display-name = "BT";
            bindings = <
                //╭─────────────────┬─────────────────┬─────────────────┬─────────────────┬─────────────────╮                      ╭─────────────────┬─────────────────┬─────────────────┬─────────────────┬─────────────────╮
                    &none             &none             &bt BT_CLR        &tog L_BT         &kp B                                    &bt BT_CLR_ALL    &kp T             &bt BT_CLR        &none             &none
                //├─────────────────┼─────────────────┼─────────────────┼─────────────────┼─────────────────┤                      ├─────────────────┼─────────────────┼─────────────────┼─────────────────┼─────────────────┤
                    &bt BT_SEL 0      &bt BT_SEL 1      &bt BT_SEL 2      &bt BT_SEL 3      &bt BT_SEL 4                             &bt BT_DISC 4     &bt BT_DISC 3     &bt BT_DISC 2     &bt BT_DISC 1     &bt BT_DISC 0
                //├─────────────────┼─────────────────┼─────────────────┼─────────────────┼─────────────────┤                      ├─────────────────┼─────────────────┼─────────────────┼─────────────────┼─────────────────┤
                    &to L_MAIN        &none             &none             &none             &none                                    &none             &none             &none             &none             &none
                //╰─────────────────┴─────────────────┼─────────────────┼─────────────────┼─────────────────┤                      ├─────────────────┼─────────────────┼─────────────────┼─────────────────┴─────────────────╯
                                                                          &trans            &trans                                   &trans            &trans
                //                                                      ╰─────────────────┴─────────────────╯                      ╰─────────────────┴─────────────────╯
            >;
        };

        hex_layer {
            display-name = "Hex";
            bindings = <
                //╭─────────────────┬─────────────────┬─────────────────┬─────────────────┬─────────────────╮                      ╭─────────────────┬─────────────────┬─────────────────┬─────────────────┬─────────────────╮
                    &trans            &none             &none             &none             &none                                    &none             &kp D             &kp E             &kp F             &trans
                //├─────────────────┼─────────────────┼─────────────────┼─────────────────┼─────────────────┤                      ├─────────────────┼─────────────────┼─────────────────┼─────────────────┼─────────────────┤
                    &none             &none             &none             &none             &none                                    &none             &kp A             &kp B             &kp C             &none 
                //├─────────────────┼─────────────────┼─────────────────┼─────────────────┼─────────────────┤                      ├─────────────────┼─────────────────┼─────────────────┼─────────────────┼─────────────────┤
                    &none             &none             &none             &none             &none                                    &kp SE_PERCENT    &kp N0            &kp X             &none             &none 
                //╰─────────────────┴─────────────────┼─────────────────┼─────────────────┼─────────────────┤                      ├─────────────────┼─────────────────┼─────────────────┼─────────────────┴─────────────────╯
                                                                          &none             &none                                    &kp SPACE         &kp N0
                //                                                      ╰─────────────────┴─────────────────╯                      ╰─────────────────┴─────────────────╯
            >;
        };

        mouse_fast_layer {
            display-name = "Mouse fast";
            // Empty by design: held from the Mouse layer, it only tells &mmv_input_listener/&msc_input_listener to scale up.
            bindings = <
                //╭─────────────────┬─────────────────┬─────────────────┬─────────────────┬─────────────────╮                      ╭─────────────────┬─────────────────┬─────────────────┬─────────────────┬─────────────────╮
                    &trans            &trans            &trans            &trans            &trans                                   &trans            &trans            &trans            &trans            &trans
                //├─────────────────┼─────────────────┼─────────────────┼─────────────────┼─────────────────┤                      ├─────────────────┼─────────────────┼─────────────────┼─────────────────┼─────────────────┤
                    &trans            &trans            &trans            &trans            &trans                                   &trans            &trans            &trans            &trans            &trans
                //├─────────────────┼─────────────────┼─────────────────┼─────────────────┼─────────────────┤                      ├─────────────────┼─────────────────┼─────────────────┼─────────────────┼─────────────────┤
                    &trans            &trans            &trans            &trans            &trans                                   &trans            &trans            &trans            &trans            &trans
                //╰─────────────────┴─────────────────┼─────────────────┼─────────────────┼─────────────────┤                      ├─────────────────┼─────────────────┼─────────────────┼─────────────────┴─────────────────╯
                                                                          &trans            &trans                                   &trans            &trans
                //                                                      ╰─────────────────┴─────────────────╯                      ╰─────────────────┴─────────────────╯
            >;
        };

        mouse_slow_layer {
            display-name = "Mouse slow";
            // Empty by design: the L_MFAST twin, scaling movement down for precision aiming.
            bindings = <
                //╭─────────────────┬─────────────────┬─────────────────┬─────────────────┬─────────────────╮                      ╭─────────────────┬─────────────────┬─────────────────┬─────────────────┬─────────────────╮
                    &trans            &trans            &trans            &trans            &trans                                   &trans            &trans            &trans            &trans            &trans
                //├─────────────────┼─────────────────┼─────────────────┼─────────────────┼─────────────────┤                      ├─────────────────┼─────────────────┼─────────────────┼─────────────────┼─────────────────┤
                    &trans            &trans            &trans            &trans            &trans                                   &trans            &trans            &trans            &trans            &trans
                //├─────────────────┼─────────────────┼─────────────────┼─────────────────┼─────────────────┤                      ├─────────────────┼─────────────────┼─────────────────┼─────────────────┼─────────────────┤
                    &trans            &trans            &trans            &trans            &trans                                   &trans            &trans            &trans            &trans            &trans
                //╰─────────────────┴─────────────────┼─────────────────┼─────────────────┼─────────────────┤                      ├─────────────────┼─────────────────┼─────────────────┼─────────────────┴─────────────────╯
                                                                          &trans            &trans                                   &trans            &trans
                //                                                      ╰─────────────────┴─────────────────╯                      ╰─────────────────┴─────────────────╯
            >;
        };
    };
};



                //╭─────────────────┬─────────────────┬─────────────────┬─────────────────┬─────────────────╮                      ╭─────────────────┬─────────────────┬─────────────────┬─────────────────┬─────────────────╮
                //  &trans            &trans            &trans            &trans            &trans                                   &trans            &trans            &trans            &trans            &trans
                //├─────────────────┼─────────────────┼─────────────────┼─────────────────┼─────────────────┤                      ├─────────────────┼─────────────────┼─────────────────┼─────────────────┼─────────────────┤
                //  &trans            &trans            &trans            &trans            &trans                                   &trans            &trans            &trans            &trans            &trans
                //├─────────────────┼─────────────────┼─────────────────┼─────────────────┼─────────────────┤                      ├─────────────────┼─────────────────┼─────────────────┼─────────────────┼─────────────────┤
                //  &trans            &trans            &trans            &trans            &trans                                   &trans            &trans            &trans            &trans            &trans
                //╰─────────────────┴─────────────────┼─────────────────┼─────────────────┼─────────────────┤                      ├─────────────────┼─────────────────┼─────────────────┼─────────────────┴─────────────────╯
                //                                                        &trans            &trans                                   &trans            &trans
                //                                                      ╰─────────────────┴─────────────────╯                      ╰─────────────────┴─────────────────╯
