## boards/shields/kibard_v2/Kconfig.shield
```kconfig
config SHIELD_KIBARD_V2_LEFT
    def_bool $(shields_list_contains,kibard_v2_left)

config SHIELD_KIBARD_V2_RIGHT
    def_bool $(shields_list_contains,kibard_v2_right)
```
